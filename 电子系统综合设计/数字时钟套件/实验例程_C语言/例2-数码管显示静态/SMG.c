/***************************************************************************
标题：	数码管的显示
实验板：数字时钟套件
作者：	芯嵌
客服QQ：
邮箱：	
说明：	静态显示一位数码管,显示0～9
******************************************************************************/

//头文件:
#include <reg52.h>

//常量定义:
unsigned char code table[]=
			{0xc0,0xf9,0xa4,0xb0,0x99,0x92,0x82,0xf8,0x80,0x90};
					//表：共阳数码管 0-9 
			
//引脚定义:		
sbit SMG_q = P3^2;	//定义数码管阳级控制脚（千位）
sbit SMG_b = P3^3;	//定义数码管阳级控制脚（百位）
sbit SMG_s = P3^4;	//定义数码管阳级控制脚（十位）
sbit SMG_g = P3^5;	//定义数码管阳级控制脚（个位）

//函数声明:
void delay(unsigned int t); //延时子函时，

//主函数，C语言的入口函数:		
void main(void)  
{
	unsigned char i;	//定义循环变量
	while(1)
	{
		SMG_g=0;		//打开位	
/*********************************************************************************
选择个位数码管，这是静态显示，P0口输出显示，不需要刷新，也可选择千位、百位或个位，
注意十位是反向的，显示值是倒过来的;
也可两位或全部同时输出显示
*********************************************************************************/
		for(i=0;i<10;i++)	//循环显示0～9
		{		
			P2=table[i];	//查表输出数码管段值给P0口，显示相应的0-9
			delay(2000);	//延时
		}
	}
}

//延时子函数,参数范围 0～65535
void delay(unsigned int t)
{
	unsigned char j;
	
	while(t--){		
		j=255;
		while(j--); 	    	
	}
}

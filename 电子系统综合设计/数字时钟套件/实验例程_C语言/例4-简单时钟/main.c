/***************************************************************************
标题：	DS1302时钟程序1
实验板：电子时钟套件
作者：	芯嵌
客服QQ：
邮箱：	
说明：	简单的显示时分
******************************************************************************/

//头文件:
#include <reg52.h>
#include "SMG4.h"
#include "DS1302.h"

//变量定义
unsigned char ly_timer[7]={0,20,12,9,7,4,15};	//0秒，20分，12时，9日，7月，星期4，15年			
						//用于读时间信息缓冲，初值为第一次的写入时间					

//主函数	
void main(void)  
{
	unsigned char oldT,DisUp=1;	//做为时间更新的显示的控制
	
	RST=0;				    	//DS1302的RST是低电平复位，因此将其关闭
	
	Set_RTC(ly_timer);	    	//写时间，芯片初始化需要先写入时间进行测试，非测试时此行去掉。
		
	while(1){		
		if(DisUp){				//更新显示时间
			DisUp=0;
			Read_RTC(ly_timer,3);						//读秒时分，其它时间信息没用到，所以不用读取
				
			ly_SMGbuf[0]=ly_timer[2]/16;		//提取小时的个位和十位，存入显示缓冲待显示
			ly_SMGbuf[1]=ly_timer[2]&0x0f;	//为什么不是除以10，这里一定注意，读出来的是BCD十进制码
			ly_SMGbuf[2]=ly_timer[1]/16;		//提取分种的个位和十位，存入显示缓冲待显示
			ly_SMGbuf[3]=ly_timer[1]&0x0f;
		}
		
		Read_RTC(ly_timer,1);					//读时间信息秒	
		if(ly_timer[0]!=oldT)  				//秒跳变更新中间点闪烁
		{
			oldT=ly_timer[0];
			ly_SMGcp[1]=oldT&0x01;			//获取秒的第0位来让中间两个小数点闪烁
			ly_SMGcp[2]=ly_SMGcp[1];
			if(oldT==0)									//秒归0时更新时间显示
				DisUp=1;
		}		
		
		DisPlayS(100);	//调用显示函数
	}
}


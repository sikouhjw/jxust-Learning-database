/***************************************************************************
标题：	AD采集温度显示
实验板：电子时钟套件
作者：	芯嵌
客服QQ：
邮箱：	
说明：	简单的显示AD转换采集回来的温度值
******************************************************************************/

//头文件:
#include <reg52.h>
#include "SMG4.h"
#include "STCADC.h"

//常量表				
code unsigned char tempbuf[] ={188,186,184,181,179,177,175,172,170,168,166,165,164,163,
																161,158,155,152,149,146,143,139,136,133,130,128,125,122,
																119,117,115,112,110,108,105,103,101,99,97,95,93,91,89,87,
																85,83,81,79,77,76,74};		//0～50度的对应值，通过热敏电阻的B值表计算所得
//变量定义
unsigned char ly_temp=0;			//保存温度值

//主函数	
void main(void)  
{
	unsigned char i;
	InitADC();
		
	while(1){		
		ADCP1STA(7);      		//启动AD转换
		ly_temp=GetADC();			//读取AD转换值
		
		for(i=0;i<50;i++)			//比较获得正确的温度值
		{
			if(ly_temp>tempbuf[i])
				break;
		}
		ly_temp=--i;
			
		ly_SMGcp[2]=1;  	//在第三位数码上显示点	
		ly_SMGbuf[2]=11;	//显示单位C
		ly_SMGbuf[3]=10;	//第四位不显示
		
		ly_SMGbuf[0]=ly_temp/10;		//温度的十位和个位分开			
		ly_SMGbuf[1]=ly_temp%10;
			
		DisPlayS(10000);	//调用显示函数
	}
}

